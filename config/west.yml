## config/west.yml
```yaml
manifest:
  remotes:
    - name: zmkfirmware
      url-base: https://github.com/stephen
  projects:
    - name: zmk
      remote: stephen
      revision: main
      import: app/west.yml
  self:
    path: config
```
